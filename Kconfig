## Kconfig
```kconfig
#
# Copyright (c) 2017 Linaro Limited
#
# SPDX-License-Identifier: Apache-2.0
#

config ARDUINO_API
	bool "ARDUINO_API"
	select CPLUSPLUS

if ARDUINO_API

config ARDUINO_UART
	bool "ARDUINO_API"
	depends on SERIAL
	depends on UART_INTERRUPT_DRIVEN
	default true

config ARDUINO_MAIN_LOOP
	bool "ARDUINO_MAIN_LOOP"
	default true
endif
```
